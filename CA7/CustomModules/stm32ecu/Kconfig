## CA7/CustomModules/stm32ecu/Kconfig
```kconfig
# SPDX-License-Identifier: GPL-2.0-only

config STM32ECU
	tristate "Mediated device driver framework"
#	depends on RPMSG
	default m
	help
	  Provides a framework to virtualize devices.
	  See Documentation/driver-api/vfio-mediated-device.rst for more details.
```

## CA7/linux-5.10.10/linux-5.10.10/drivers/stm32ecu/Kconfig
```kconfig
# SPDX-License-Identifier: GPL-2.0-only
#
# stm32ecu driver configuration
#
menuconfig STM32ECU
	bool "stm32ecu support"
    default y
	depends on HAS_IOMEM
	help
	  STM32 ECU support

if STM32ECU

config STM32ECU_DEBUG
	bool "Debug support for SPI drivers"
    default y
	depends on DEBUG_KERNEL
	help
	  Say "yes" to enable debug.

endif # STM32ECU
```
